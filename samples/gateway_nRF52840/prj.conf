## CMakeLists.txt
```
#
# Copyright (c) 2019 Nordic Semiconductor
#
# SPDX-License-Identifier: LicenseRef-Nordic-5-Clause
#

cmake_minimum_required(VERSION 3.20.0)

find_package(Zephyr REQUIRED HINTS $ENV{ZEPHYR_BASE})
project(mesh_bot)

# Include application application event headers
zephyr_library_include_directories(src/events)

# NORDIC SDK APP START
target_sources(app PRIVATE 
    src/main.c
    src/model_handler.c
    src/uart_handler.c
    src/robot_movement_cli.c
)

include_directories(
    src
    ../common/mesh_model_defines
)
# NORDIC SDK APP END
```

## Kconfig
```
#
# Copyright (c) 2021 Nordic Semiconductor ASA
#
# SPDX-License-Identifier: LicenseRef-Nordic-5-Clause
#

menu "Gateway nRF52840"

config GATEWAY_NRF52840_VERSION
	string "Gateway nRF52840 firmware version"
	default "0.0.0-development"

config MESH_ROBOT_VERSION_MAX_LEN
	int "Maximum length of the application firmware version"
	default 150

config MESH_UART_RX_BUF_SIZE
	int "UART RX buffer size"
	default 256

config MESH_UART_RX_BUF_COUNT
	int "UART RX buffer count"
	default 4

config UART_THREAD_STACK_SIZE
	int "UART thread stack size"
	default 2048

config UART_THREAD_PRIORITY
	int "UART thread priority"
	default 5

module = APPLICATION_MODULE
module-str = Application module
source "subsys/logging/Kconfig.template.log_config"

module = UART_MODULE
module-str = Uart module
source "subsys/logging/Kconfig.template.log_config"

module = ROBOT_CONFIG_CLIENT
module-str = Robot config client
source "subsys/logging/Kconfig.template.log_config"

endmenu

menu "Zephyr Kernel"
source "Kconfig.zephyr"
endmenu
```

## prj.conf
```kconfig
#
# Copyright (c) 2019 Nordic Semiconductor ASA
#
# SPDX-License-Identifier: LicenseRef-Nordic-5-Clause
#


# Logger configuration
CONFIG_LOG=y
CONFIG_LOG_DEFAULT_LEVEL=4
CONFIG_LOG_BACKEND_UART=y

# Memory
CONFIG_MAIN_STACK_SIZE=4096
CONFIG_HEAP_MEM_POOL_SIZE=2048

# NewLib C
CONFIG_NEWLIB_LIBC=y


# Debug
CONFIG_DEBUG_OPTIMIZATIONS=y
CONFIG_DEBUG_THREAD_INFO=y


# Memory
CONFIG_SYSTEM_WORKQUEUE_STACK_SIZE=2048
CONFIG_FLASH=y
CONFIG_FLASH_MAP=y
CONFIG_NVS=y
CONFIG_PARTITION_MANAGER_ENABLED=y
CONFIG_PM_SINGLE_IMAGE=y
CONFIG_PM_PARTITION_SIZE_SETTINGS_STORAGE=0x8000

# DK specific configs
CONFIG_DK_LIBRARY=y
CONFIG_HWINFO=y

# Settings
CONFIG_SETTINGS=y
CONFIG_BT_SETTINGS=y

# UART
CONFIG_SERIAL=y
CONFIG_UART_ASYNC_API=y
CONFIG_UART_1_NRF_HW_ASYNC=y
CONFIG_UART_1_NRF_HW_ASYNC_TIMER=2
CONFIG_UART_LINE_CTRL=y

# Bluetooth
CONFIG_BT=y
CONFIG_BT_COMPANY_ID=0x0059
CONFIG_BT_DEVICE_NAME="nRF Robot War Gateway"
CONFIG_BT_L2CAP_TX_MTU=69
CONFIG_BT_L2CAP_TX_BUF_COUNT=8
CONFIG_BT_OBSERVER=y
CONFIG_BT_PERIPHERAL=y
CONFIG_BT_RX_STACK_SIZE=4096
CONFIG_BT_ECC=y
CONFIG_BT_TINYCRYPT_ECC=y

CONFIG_BT_WAIT_NOP=n

# Bluetooth mesh
CONFIG_BT_MESH=y
CONFIG_BT_MESH_RELAY=y
CONFIG_BT_MESH_FRIEND=y
CONFIG_BT_MESH_ADV_BUF_COUNT=13
CONFIG_BT_MESH_RX_SEG_MAX=10
CONFIG_BT_MESH_TX_SEG_MAX=10
CONFIG_BT_MESH_PB_GATT=y
CONFIG_BT_MESH_GATT_PROXY=y
CONFIG_BT_MESH_DK_PROV=y
```

## boards/nrf9160dk_nrf52840.overlay
```dts
#include <nrf9160dk_nrf52840_reset_on_if5.dtsi>
#include <nrf9160dk_uart1_on_if0_3.dtsi>

&uart1 {
    status="okay";
    current-speed = <115200>; 
};

&nrf_interface_pins_0_2_routing {
    status="okay";
};

&nrf_interface_pins_3_5_routing {
    status="okay";
};
```

## boards/nrf9160dk_nrf52840_0_14_0.overlay
```dts
#include <nrf9160dk_nrf52840_reset_on_if9.dtsi>
```

## src/main.c
```c
/*
 * Copyright (c) 2019 Nordic Semiconductor ASA
 *
 * SPDX-License-Identifier: LicenseRef-Nordic-5-Clause
 */

#include <zephyr/logging/log.h>
#include <zephyr/device.h>
#include <zephyr/bluetooth/bluetooth.h>
#include <zephyr/bluetooth/mesh.h>
#include <dk_buttons_and_leds.h>
#include <bluetooth/mesh/dk_prov.h>

#define MODULE main

#include <zephyr/logging/log.h>
LOG_MODULE_REGISTER(MODULE, CONFIG_APPLICATION_MODULE_LOG_LEVEL);

#include "uart_handler.h"
#include "model_handler.h"
#include "robot_movement_cli.h"

static const struct device *mesh_uart = DEVICE_DT_GET(DT_NODELABEL(uart1));

static struct bt_mesh_robot_config_cli *config_client;

static int setup_mesh()
{
	int err;
	err = bt_enable(NULL);
	if (err)
	{
		LOG_ERR("Failed to initialize bluetooth: Error %d", err);
		return err;
	}
	LOG_DBG("Bluetooth initialized");
	err = bt_mesh_init(bt_mesh_dk_prov_init(), model_handler_init(&config_client));
	if (err)
	{
		LOG_ERR("Failed to initialize mesh: Error %d", err);
		return err;
	}

	if (IS_ENABLED(CONFIG_SETTINGS))
	{
		err = settings_load();
		if (err)
		{
			LOG_ERR("Failed to load settings: Error %d", err);
		}
	}

	err = bt_mesh_prov_enable(BT_MESH_PROV_ADV | BT_MESH_PROV_GATT);
	if (err == -EALREADY)
	{
		LOG_DBG("Device already provisioned");
		LOG_DBG("Mesh initialized");
	}

	return 0;
}

void main(void)
{
	int err = 0;
	err = setup_mesh();
	if (err)
	{
		LOG_ERR("Failed to setup mesh: Error %d", err);
		return;
	}

	err = init_uart(mesh_uart, config_client);
	if (err)
	{
		LOG_ERR("Could not initialize UART: Error %d", err);
		return;
	}
}
```

## src/model_handler.c
```c
#include <zephyr/sys/byteorder.h>
#include <zephyr/bluetooth/mesh/msg.h>

#include "../../common/mesh_model_defines/robot_movement_cli.h"
#include "model_handler.h"
#include "robot_movement_cli.h"

/* SIG models */

static void attention_on(struct bt_mesh_model *model)
{
    printk("attention_on()\n");
}

static void attention_off(struct bt_mesh_model *model)
{
    printk("attention_off()\n");
}

static const struct bt_mesh_health_srv_cb health_srv_cb = {
    .attn_on = attention_on,
    .attn_off = attention_off,
};

static struct bt_mesh_health_srv health_srv = {
    .cb = &health_srv_cb,
};

BT_MESH_HEALTH_PUB_DEFINE(health_pub, 0);

static struct bt_mesh_model sig_models[] = {
    BT_MESH_MODEL_CFG_SRV,
    BT_MESH_MODEL_HEALTH_SRV(&health_srv, &health_pub),
};

/* Vendor models */

struct bt_mesh_robot_config_cli robot_conf_cli;

static struct bt_mesh_model vendor_models[] = {
    BT_MESH_MODEL_VND_ROBOT_CONFIG_CLI(&robot_conf_cli),
};

/* Composition */
static struct bt_mesh_elem elements[] = {
    BT_MESH_ELEM(0, sig_models, vendor_models),
};

static struct bt_mesh_comp comp = {
    .cid = CONFIG_BT_COMPANY_ID,
    .elem = elements,
    .elem_count = ARRAY_SIZE(elements),
};

const struct bt_mesh_comp *model_handler_init(struct bt_mesh_robot_config_cli **config_client)
{
    *config_client = &robot_conf_cli;
    (*config_client)->model = &vendor_models[0];
    bt_mesh_msg_ack_ctx_init(&(*config_client)->ack_ctx);
    return &comp;
}
```

## src/model_handler.h
```c
#pragma once

#include <zephyr/bluetooth/mesh.h>
#include "../../common/mesh_model_defines/robot_movement_srv.h"
#include "./robot_movement_cli.h"

const struct bt_mesh_comp *model_handler_init(struct bt_mesh_robot_config_cli **config_client);
```

## src/robot_movement_cli.c
```c
#include <zephyr.h>
#include <zephyr/bluetooth/mesh.h>
#include "./robot_movement_cli.h"
#include "../../common/mesh_model_defines/robot_movement_cli.h"

#define MODULE robot_config_client

#include <zephyr/logging/log.h>
LOG_MODULE_REGISTER(MODULE, CONFIG_ROBOT_CONFIG_CLIENT_LOG_LEVEL);

/* Sent commands */

int configure_robot_movement(struct bt_mesh_robot_config_cli *config_client, uint16_t address, struct robot_movement_set_msg msg)
{
    if (!bt_mesh_is_provisioned())
    {
        LOG_ERR("Device not provisioned");
        return -EAGAIN;
    }
    struct bt_mesh_msg_ctx ctx =
        {
            .addr = address,
            .app_idx = config_client->model->keys[0],
            .send_ttl = BT_MESH_TTL_DEFAULT,
            .send_rel = false,
        };

    if (bt_mesh_msg_ack_ctx_prepare(&config_client->ack_ctx, OP_VND_ROBOT_MOVEMENT_SET_STATUS, address, NULL)){
        LOG_ERR("Failed to prepare ack ctx");
        return -EALREADY;
    }

    BT_MESH_MODEL_BUF_DEFINE(buf, OP_VND_ROBOT_MOVEMENT_SET, sizeof(struct robot_movement_set_msg));
    bt_mesh_model_msg_init(&buf, OP_VND_ROBOT_MOVEMENT_SET);
    net_buf_simple_add_be32(&buf, msg.time);
    net_buf_simple_add_be32(&buf, msg.angle);
    int err = bt_mesh_model_send(config_client->model, &ctx, &buf, NULL, NULL);
    if (err)
    {
        LOG_ERR("Failed to send message (err %d)", err);
        bt_mesh_msg_ack_ctx_clear(&config_client->ack_ctx);
        return err;
    }

    return bt_mesh_msg_ack_ctx_wait(&config_client->ack_ctx, K_MSEC((CONFIG_BT_MESH_MOD_ACKD_TIMEOUT_BASE + 256 * CONFIG_BT_MESH_MOD_ACKD_TIMEOUT_PER_HOP)));
}

int send_clear_to_move(struct bt_mesh_robot_config_cli *config_client, uint16_t address)
{
    if (!bt_mesh_is_provisioned())
    {
        LOG_ERR("Device not provisioned");
        return -EAGAIN;
    }
    struct bt_mesh_msg_ctx ctx =
        {
            .addr = address,
            .app_idx = config_client->model->keys[0],
            .send_ttl = BT_MESH_TTL_DEFAULT,
            .send_rel = false,
        };

    BT_MESH_MODEL_BUF_DEFINE(buf, OP_VND_ROBOT_CLEAR_TO_MOVE, 0);
    bt_mesh_model_msg_init(&buf, OP_VND_ROBOT_CLEAR_TO_MOVE);

    return bt_mesh_model_send(config_client->model, &ctx, &buf, NULL, NULL);
}

/* Received commands */
static int handle_robot_movement_done_status(struct bt_mesh_model *model, struct bt_mesh_msg_ctx *ctx, struct net_buf_simple *buf)
{
    LOG_DBG("Movement done status received");
    return 0;
}

static int handle_robot_movement_set_status(struct bt_mesh_model *model, struct bt_mesh_msg_ctx *ctx, struct net_buf_simple *buf)
{
    LOG_DBG("Movement set status received");
    struct bt_mesh_robot_config_cli *config_client = model->user_data;

    if (bt_mesh_msg_ack_ctx_match(&config_client->ack_ctx, OP_VND_ROBOT_MOVEMENT_SET_STATUS, ctx->addr, NULL))
    {
        bt_mesh_msg_ack_ctx_rx(&config_client->ack_ctx);
        LOG_DBG("ACK received for movement set message");
    }

    // TODO: Inform rest of system
    return 0;
}

/* Model callbacks */
const struct bt_mesh_model_cb robot_config_cli_cb;

/* Model operations */
const struct bt_mesh_model_op robot_config_cli_ops[] = {
    {
        OP_VND_ROBOT_MOVEMENT_DONE_STATUS,
        sizeof(struct robot_movement_done_status_msg),
        handle_robot_movement_done_status,
    },
    {
        OP_VND_ROBOT_MOVEMENT_SET_STATUS,
        sizeof(struct robot_movement_set_status_msg),
        handle_robot_movement_set_status,
    },
    BT_MESH_MODEL_OP_END,
};
```

## src/robot_movement_cli.h
```c
#pragma once

#include <zephyr/bluetooth/mesh.h>
#include <bluetooth/mesh/model_types.h>
#include "../../common/mesh_model_defines/robot_movement_srv.h"

// Defined in model_handler.c
extern const struct bt_mesh_model_op robot_config_cli_ops[];
extern const struct bt_mesh_model_cb robot_config_cli_cb;

struct bt_mesh_robot_config_cli_handlers {
};

struct bt_mesh_robot_config_cli
{
    struct bt_mesh_model *model;
    struct bt_mesh_model_pub pub;
    struct net_buf_simple pub_msg;
    uint8_t buf[BT_MESH_MODEL_BUF_LEN(OP_VND_ROBOT_CLEAR_TO_MOVE, 0)];
    struct bt_mesh_robot_config_cli_handlers handlers;
    struct bt_mesh_msg_ack_ctx ack_ctx;
};

#define BT_MESH_MODEL_VND_ROBOT_CONFIG_CLI(_robot_config_cli)                        \
    BT_MESH_MODEL_VND_CB(                                                            \
        CONFIG_BT_COMPANY_ID,                                                        \
        ROBOT_MOVEMENT_CLI_MODEL_ID,                                                 \
        robot_config_cli_ops,                                                        \
        &(_robot_config_cli)->pub,                                                   \
        BT_MESH_MODEL_USER_DATA(struct bt_mesh_robot_config_cli, _robot_config_cli), \
        &robot_config_cli_cb)

/**
 * @brief Configure the next movement for a robot.
 *
 * @param config_client The robot configuration client to send from
 * @param address Address of robot to configure.
 * @param msg Movement configuration
 * @return 0 on success, negative error code otherwise.
 */
int configure_robot_movement(struct bt_mesh_robot_config_cli *config_client, uint16_t address, struct robot_movement_set_msg msg);

/**
 * @brief Signal a robot that it should start moving.
 *
 * @param config_client The robot configuration client to send from
 * @param address Address of robot to configure.
 * @return 0 on success, negative error code otherwise.
 */
int send_clear_to_move(struct bt_mesh_robot_config_cli *config_client, uint16_t address);
```

## src/uart_handler.c
```c
#include <zephyr.h>
#include <zephyr/drivers/uart.h>

#include "./robot_movement_cli.h"
#include "uart_handler.h"

#define MODULE uart

#include <zephyr/logging/log.h>
LOG_MODULE_REGISTER(MODULE, CONFIG_UART_MODULE_LOG_LEVEL);

struct uart_thread_msg
{
	struct device *uart_dev;
	struct bt_mesh_robot_config_cli *config_client;
	union mesh_uart_msg msg;
};
K_MSGQ_DEFINE(uart_msg_queue, sizeof(struct uart_thread_msg), 4, 4);

K_MEM_SLAB_DEFINE_STATIC(mesh_uart_rx_slab, CONFIG_MESH_UART_RX_BUF_SIZE, CONFIG_MESH_UART_RX_BUF_COUNT, 4);

static int uart_data_rx_rdy_handler(const struct device *dev, struct uart_event_rx event_data, struct bt_mesh_robot_config_cli *config_client)
{
	static union mesh_uart_msg msg;
	static size_t current_msg_len = 0; // Length of currently received fragment

	uint8_t *msg_fill_start = ((uint8_t *)&msg) + current_msg_len;
	memcpy(msg_fill_start, (event_data.buf + event_data.offset), event_data.len);
	current_msg_len += event_data.len;

	LOG_DBG("Message fragment received: length: %d offset: %d", event_data.len, event_data.offset);
	if (current_msg_len < sizeof(msg.header))
	{
		return 0; // Header not yet received. Keep waiting for more data.
	}

	struct uart_thread_msg thread_msg; // Prepare message for message queue
	thread_msg.uart_dev = dev;
	thread_msg.config_client = config_client;
	thread_msg.msg = msg;

	LOG_DBG("Got message with type %d", msg.header.type);
	switch (msg.header.type)
	{
	case HELLO:
	{
		if (current_msg_len < sizeof(msg.hello))
		{
			return 0; // Message not complete. Keep waiting for more data.
		}
		LOG_DBG("UART \"HELLO\" received");
		int err = k_msgq_put(&uart_msg_queue, &thread_msg, K_NO_WAIT);
		if (err)
		{
			LOG_ERR("Failed to enqueue message: Error %d", err);
		}
		break;
	}
	case CLEAR_TO_MOVE:
	{
		if (current_msg_len < sizeof(msg.clear_to_move))
		{
			return 0; // Message not complete. Keep waiting for more data.
		}
		LOG_DBG("UART \"CLEAR_TO_MOVE\" received");
		int err = k_msgq_put(&uart_msg_queue, &thread_msg, K_NO_WAIT);
		if (err)
		{
			LOG_ERR("Failed to enqueue message: Error %d", err);
		}
		break;
	}
	case SET_MOVEMENT_CONFIG:
	{
		if (current_msg_len < sizeof(msg.set_movement_config))
		{
			return 0; // Message not complete. Keep waiting for more data.
		}
		LOG_DBG("UART \"SET_MOVEMENT_CONFIG\" received");
		int err = k_msgq_put(&uart_msg_queue, &thread_msg, K_NO_WAIT);
		if (err)
		{
			LOG_ERR("Failed to enqueue message: Error %d", err);
		}
		break;
	}
	default:
	{
		LOG_ERR("Unknown message type %d", msg.header.type);
		return -EINVAL;
	}
	}
	current_msg_len = 0;

	return 0;
}

static K_SEM_DEFINE(uart_tx_sem, 1, 1);
static int mesh_uart_send(const struct device *dev, void *data, size_t len, k_timeout_t timeout)
{
	int err = k_sem_take(&uart_tx_sem, timeout);
	if (err)
	{
		LOG_ERR("Failed to take semaphore: Error %d", err);
		return err;
	}
	err = uart_tx(dev, data, len, SYS_FOREVER_US);
	if (err)
	{
		LOG_ERR("Failed to send data: Error %d", err);
		return err;
	}
	return 0;
}

static int mesh_uart_send_status(const struct device *dev, int status, k_timeout_t timeout)
{
	static struct mesh_uart_status_msg msg;
	msg.header.type = STATUS;
	msg.data.status = status;
	return mesh_uart_send(dev, &msg, sizeof(msg), timeout);
}

static int mesh_uart_send_hello(const struct device *dev, uint16_t echo, k_timeout_t timeout)
{
	static struct mesh_uart_hello_msg msg;
	msg.header.type = HELLO;
	msg.echo = echo;
	return mesh_uart_send(dev, &msg, sizeof(msg), timeout);
}

static int mesh_uart_send_movement_config_accepted(const struct device *dev, struct mesh_uart_movement_config config, k_timeout_t timeout)
{
	static struct mesh_uart_movement_config_accepted_msg msg;
	msg.header.type = MOVEMENT_CONFIG_ACCEPTED;
	msg.data = config;
	return mesh_uart_send(dev, &msg, sizeof(msg), timeout);
}

static void uart_callback(const struct device *dev, struct uart_event *event, void *user_data)
{
	struct bt_mesh_robot_config_cli *config_client = (struct bt_mesh_robot_config_cli *)user_data;
	switch (event->type)
	{
	case UART_TX_DONE:
	{
		LOG_DBG("UART_TX_DONE: Sent %d bytes", event->data.tx.len);
		k_sem_give(&uart_tx_sem);
		break;
	}
	case UART_TX_ABORTED:
	{
		LOG_ERR("UART_TX_ABORTED");
		k_sem_give(&uart_tx_sem);
		break;
	}
	case UART_RX_RDY:
	{
		LOG_DBG("UART_RX_RDY");
		uart_data_rx_rdy_handler(dev, event->data.rx, config_client);
		break;
	}
	case UART_RX_BUF_REQUEST:
	{
		LOG_DBG("UART_RX_BUF_REQUEST");
		void *new_buf;
		int err = k_mem_slab_alloc(&mesh_uart_rx_slab, &new_buf, K_NO_WAIT);
		if (err)
		{
			LOG_ERR("Could not allocate new buffer: Error %d", err);
		}
		else
		{
			err = uart_rx_buf_rsp(dev, new_buf, CONFIG_MESH_UART_RX_BUF_SIZE);
			if (err)
			{
				LOG_ERR("Could not set new buffer: Error %d", err);
			}
		}
		break;
	}
	case UART_RX_BUF_RELEASED:
	{
		LOG_DBG("UART_RX_BUF_RELEASED");
		k_mem_slab_free(&mesh_uart_rx_slab, (void **)&event->data.rx_buf.buf);
		break;
	}
	case UART_RX_DISABLED:
	{
		LOG_DBG("UART_RX_DISABLED");
		break;
	}
	case UART_RX_STOPPED:
	{
		LOG_DBG("UART_RX_STOPPED: Reason: %d", event->data.rx_stop.reason);
		break;
	}
	default:
		LOG_ERR("Unknown UART event type %d", event->type);
		break;
	}
}

int init_uart(const struct device *uart_dev, struct bt_mesh_robot_config_cli *config_client)
{
	int err = 0;

	if (!device_is_ready(uart_dev))
	{
		LOG_ERR("UART device not ready");
		return -ENODEV;
	}
	LOG_DBG("UART device ready");

	err = uart_callback_set(uart_dev, uart_callback, (void *)config_client);
	if (err)
	{
		LOG_ERR("Failed to set UART callback: Error %d", err);
		return err;
	}
	void *initial_rx_buf;
	err = k_mem_slab_alloc(&mesh_uart_rx_slab, &initial_rx_buf, K_NO_WAIT);
	if (err)
	{
		LOG_ERR("Could not allocate initial RX buffer");
		return err;
	}
	uart_rx_enable(uart_dev, initial_rx_buf, CONFIG_MESH_UART_RX_BUF_SIZE, 1000);
	return 0;
}

static void uart_thread_fn(void *arg1, void *arg2, void *arg3)
{
	LOG_DBG("Starting UART thread");
	struct uart_thread_msg thread_msg;
	while (true)
	{
		int err = k_msgq_get(&uart_msg_queue, &thread_msg, K_FOREVER);
		if (err)
		{
			LOG_ERR("Failed to dequeue message: Error %d", err);
			continue;
		}
		switch (thread_msg.msg.header.type)
		{
		case HELLO:
		{
			mesh_uart_send_hello(thread_msg.uart_dev, thread_msg.msg.hello.echo, K_FOREVER);
			break;
		}
		case CLEAR_TO_MOVE:
		{
			err = send_clear_to_move(thread_msg.config_client, BT_MESH_ADDR_ALL_NODES);
			if (err)
			{
				LOG_ERR("Failed to send CLEAR_TO_MOVE: Error %d", err);
			}
			break;
		}
		case SET_MOVEMENT_CONFIG:
		{
			struct robot_movement_set_msg movement_config;
			movement_config.time = thread_msg.msg.set_movement_config.data.time;
			movement_config.angle = thread_msg.msg.set_movement_config.data.angle;
			err = configure_robot_movement(thread_msg.config_client, thread_msg.msg.set_movement_config.data.addr, movement_config);
			if (err)
			{
				LOG_ERR("Failed to set robot movement configuration: Error %d", err);
			} else {
				struct mesh_uart_movement_config accepted_config;
				accepted_config.addr = thread_msg.msg.set_movement_config.data.addr;
				accepted_config.time = movement_config.time;
				accepted_config.angle = movement_config.angle;
				mesh_uart_send_movement_config_accepted(thread_msg.uart_dev, accepted_config, K_FOREVER);
			}
			mesh_uart_send_status(thread_msg.uart_dev, err, K_FOREVER);
			break;
		}
		default:
		{
			LOG_ERR("Unknown message type %d", thread_msg.msg.header.type);
			break;
		}
		}
	}
}

K_THREAD_DEFINE(uart_thread, CONFIG_UART_THREAD_STACK_SIZE, uart_thread_fn, NULL, NULL, NULL, CONFIG_UART_THREAD_PRIORITY, 0, 0);
```

## src/uart_handler.h
```c
#pragma once
#include <zephyr/device.h>
#include "../../common/nRF9160dk_uart_interface/messages.h"
#include "robot_movement_cli.h"

int init_uart(const struct device *dev, struct bt_mesh_robot_config_cli *config_client);
```
