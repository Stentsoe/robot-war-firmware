## samples/gateway_nRF9160/src/modules/Kconfig.mesh_module
```kconfig
#
# Copyright (c) 2021 Nordic Semiconductor
#
# SPDX-License-Identifier: LicenseRef-Nordic-5-Clause
#

menu "MESH module"

config MESH_THREAD_STACK_SIZE
	int "Mesh module thread stack size"
	default 2048

config MESH_UART_RX_BUF_SIZE
	int "Mesh module UART RX buffer size"
	default 256

config MESH_UART_RX_BUF_COUNT
	int "Mesh module UART RX buffer count"
	default 4

module = MESH_MODULE
module-str = Mesh module
source "subsys/logging/Kconfig.template.log_config"
	  
endmenu
```

## samples/mesh_bot/src/models/Kconfig.id_srv
```kconfig
menu "ID server"

config ID_SRV_MAX_LEN
	int "Max length of id"
	default 48
	  
endmenu
```
